## arch/arm/configs/k80hd_bsp_fwv_512m_defconfig
```kconfig
#
# Tecno Pop 4 Air (BC1-VP650ABC) Minimal LCM Bringup defconfig
# Based on k80hd_bsp_fwv_512m_defconfig + stock defconfig
# Target: Verify ST7703 LCM display initialization in isolation
#

CONFIG_MACH_MT6580=y
CONFIG_CROSS_COMPILE="arm-eabi-"
CONFIG_LOG_BUF_SHIFT=18
CONFIG_CC_STACKPROTECTOR_STRONG=y
CONFIG_SMP=y
CONFIG_HAVE_ARM_ARCH_TIMER=y
CONFIG_PREEMPT=y
CONFIG_AEABI=y
CONFIG_HIGHMEM=y
CONFIG_CMA_AREAS=1
CONFIG_ZSMALLOC=y
CONFIG_BUILD_ARM_APPENDED_DTB_IMAGE=y
CONFIG_BUILD_ARM_APPENDED_DTB_IMAGE_NAMES="mt6580"
CONFIG_BUILD_ARM_DTB_OVERLAY_IMAGE_NAMES="k80hd_bsp_fwv_512m"
CONFIG_CMDLINE="console=tty0 console=ttyMT3,921600n1 root=/dev/ram vmalloc=400M slub_debug=OFZPU page_owner=on swiotlb=noforce androidboot.hardware=mt6580 firmware_class.path=/vendor/firmware loop.max_part=7"
CONFIG_CPU_FREQ=y
CONFIG_CPU_FREQ_DEFAULT_GOV_INTERACTIVE=y
CONFIG_CPU_FREQ_GOV_POWERSAVE=y
CONFIG_CPU_FREQ_GOV_USERSPACE=y
CONFIG_CPU_FREQ_GOV_ONDEMAND=y
CONFIG_VFP=y
CONFIG_NEON=y
CONFIG_EXTREME_LOW_RAM=y
CONFIG_BLK_DEV_LOOP=y
CONFIG_BLK_DEV_LOOP_MIN_COUNT=16

#
# MediaTek Core Platform
#
CONFIG_MEDIATEK_SOLUTION=y
CONFIG_MTK_PLATFORM="mt6580"
CONFIG_ARCH_MTK_PROJECT="k80hd_bsp_fwv_512m"
CONFIG_MTK_NO_ATF=y
CONFIG_MTK_GPT_SCHEME_SUPPORT=y
CONFIG_MTK_BASE_POWER=y
CONFIG_MTK_POWER_GS=y
CONFIG_MTK_FREQ_HOPPING=y
CONFIG_MTK_CLKMGR=y
CONFIG_MTK_PMIC_WRAP_HAL=y
CONFIG_MTK_CHIP=y
CONFIG_MTK_IRQ=y
CONFIG_STACKTRACE=y
CONFIG_MTK_SERIAL=y
CONFIG_SERIAL_MT65XX=y
CONFIG_SERIAL_MT65XX_CONSOLE=y
CONFIG_MTK_PWM=y
CONFIG_MTK_LEDS=y
CONFIG_NEW_LEDS=y
CONFIG_LEDS_CLASS=y
CONFIG_MTK_RTC=y
CONFIG_MTK_RAM_CONSOLE=y
CONFIG_MTK_CMDQ=y
CONFIG_MTK_SYNC=y
CONFIG_MTK_SYSENV=y
CONFIG_MTK_MEMCFG=y

#
# Display / LCM Subsystem (PRIMARY FOCUS)
#
CONFIG_FB=y
CONFIG_FB_CMDLINE=y
CONFIG_FB_NOTIFY=y
CONFIG_FB_CFB_FILLRECT=y
CONFIG_FB_CFB_COPYAREA=y
CONFIG_FB_CFB_IMAGEBLIT=y
CONFIG_FB_MODE_HELPERS=y
CONFIG_FB_TILEBLITTING=y
CONFIG_MTK_FB=y
CONFIG_MTK_VIDEOX=y
CONFIG_MTK_LCM=y
CONFIG_CUSTOM_KERNEL_LCM="st7703_hdminus_dsi_vdo_dezhixin_vp650"
# CONFIG_MTK_LCM_DEVICE_TREE_SUPPORT is not set
CONFIG_MTK_LCM_PHYSICAL_ROTATION="0"
CONFIG_LCM_HEIGHT="1200"
CONFIG_LCM_WIDTH="540"
CONFIG_CUSTOM_LCM_X="0"
CONFIG_CUSTOM_LCM_Y="0"
CONFIG_MTK_FB_SUPPORT_ASSERTION_LAYER=y
CONFIG_MTK_PQ_COLOR_MODE="DISP"

#
# Disabled Drivers (to prevent early panics during LCM test)
#
# CONFIG_MTK_IMGSENSOR is not set
# CONFIG_CUSTOM_KERNEL_IMGSENSOR is not set
# CONFIG_MTK_LENS is not set
# CONFIG_MTK_FLASHLIGHT is not set
# CONFIG_INPUT_TOUCHSCREEN is not set
# CONFIG_TOUCHSCREEN_MTK is not set
# CONFIG_MTK_SENSOR_SUPPORT is not set
# CONFIG_CUSTOM_KERNEL_ACCELEROMETER is not set
# CONFIG_CUSTOM_KERNEL_ALSPS is not set
# CONFIG_CUSTOM_KERNEL_GYROSCOPE is not set
# CONFIG_CUSTOM_KERNEL_MAGNETOMETER is not set
# CONFIG_MTK_CCCI_DRIVER is not set
# CONFIG_MTK_CCCI_EXT is not set
# CONFIG_MTK_MD1_SUPPORT is not set
# CONFIG_MTK_COMBO is not set
# CONFIG_MTK_COMBO_WIFI is not set
# CONFIG_MTK_COMBO_BT is not set
# CONFIG_MTK_COMBO_GPS is not set
# CONFIG_MTK_FMRADIO is not set
# CONFIG_SOUND is not set
# CONFIG_SND is not set

#
# Storage & Input
#
CONFIG_MMC=y
CONFIG_MMC_BLOCK_MINORS=32
CONFIG_MMC_MTK_PRO=y
CONFIG_MTK_EMMC_SUPPORT=y
CONFIG_MTK_EMMC_CACHE=y
CONFIG_INPUT_EVDEV=y
CONFIG_KEYBOARD_MTK=y
CONFIG_ONEKEY_REBOOT_NORMAL_MODE=y
CONFIG_KPD_PWRKEY_USE_PMIC=y

#
# Debugging & Crash Analysis
#
CONFIG_PRINTK_TIME=y
CONFIG_DEBUG_INFO=y
CONFIG_PANIC_TIMEOUT=0
CONFIG_ARM_UNWIND=y
CONFIG_DEBUG_BUGVERBOSE=y
```

## drivers/misc/mediatek/camera_assistant/Kconfig
```kconfig
config SAGEREAL_CAMERA_ASSISTANT_DRV
	bool "Sagereal camera assistant driver"
	default n
```

## drivers/misc/mediatek/sensors-1.0/accelerometer/sc7a20/Kconfig
```kconfig
config GSENSOR_SC7A20
	bool "SC7A20 for MediaTek package"
	default n
	help
	  Say Y here if you have Silan SC7A20 3-axis accelerometer.
```
